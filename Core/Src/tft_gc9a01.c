#include "tft_gc9a01.h"
//BỘ ĐỆM MÀN HÌNH (CHỐNG TRÀN RAM)
static uint16_t gfx_buffer[1024];

// CẤU HÌNH FONT CHỮ
// Muốn đổi font thì 2 case:
// 1/ size 5x8 (ko cần chỉnh hàm vẽ kí tự)
// 2/ khác size (chỉnh lại hàm vẽ kí tự)
static const uint8_t font5x8[] = {
  0x00,0x00,0x00,0x00,0x00, 0x00,0x00,0x5F,0x00,0x00, 0x00,0x07,0x00,0x07,0x00, 0x14,0x7F,0x14,0x7F,0x14,
  0x24,0x2A,0x7F,0x2A,0x12, 0x23,0x13,0x08,0x64,0x62, 0x36,0x49,0x55,0x22,0x50, 0x00,0x05,0x03,0x00,0x00,
  0x00,0x1C,0x22,0x41,0x00, 0x00,0x41,0x22,0x1C,0x00, 0x08,0x2A,0x1C,0x2A,0x08, 0x08,0x08,0x3E,0x08,0x08,
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  0x00,0x00,0x7F,0x00,0x00, 0x00,0x41,0x36,0x08,0x00, 0x08,0x08,0x2A,0x1C,0x08, 0x08,0x1C,0x2A,0x08,0x08
};

static uint8_t current_text_datum = TL_DATUM;
static uint8_t current_text_size = 1;


void TFT_FillScreen(GC9A01A *tft, uint16_t color) {
    for(int i = 0; i < 240; i++) gfx_buffer[i] = color;

    GC9A01A_start_spi_transaction(tft);
    GC9A01A_set_addr_window(tft, 0, 0, TFT_WIDTH, TFT_HEIGHT);
    GC9A01A_set_spi_datasize(tft, SPI_DATASIZE_16BIT);
    for(int y = 0; y < 240; y++) {
        GC9A01A_transmit_data(tft, 240, gfx_buffer);
    }
    GC9A01A_end_spi_transaction(tft);
}

void TFT_DrawFastVLine(GC9A01A* tft, int16_t x, int16_t y, int16_t h, uint16_t color) {
    if (x >= TFT_WIDTH || y >= TFT_HEIGHT) return;
    if (y + h > TFT_HEIGHT) h = TFT_HEIGHT - y;
    if (h > 1024) h = 1024;

    for(int i = 0; i < h; i++) gfx_buffer[i] = color;
    GC9A01A_draw_pixels(tft, x, y, gfx_buffer, 1, h);
}

void TFT_DrawFastHLine(GC9A01A *tft, int16_t x, int16_t y, int16_t w, uint16_t color) {
    if (x >= TFT_WIDTH || y >= TFT_HEIGHT) return;
    if (x + w > TFT_WIDTH) w = TFT_WIDTH - x;
    if (w > 1024) w = 1024;

    for(int i = 0; i < w; i++) gfx_buffer[i] = color;
    GC9A01A_draw_pixels(tft, x, y, gfx_buffer, w, 1);
}


void TFT_SetTextDatum(uint8_t datum) { current_text_datum = datum; }
void TFT_SetTextSize(uint8_t size) { current_text_size = size; }

// Hàm vẽ ký tự (có đệm)
void TFT_DrawChar(GC9A01A *tft, int16_t x, int16_t y, unsigned char c, uint16_t color, uint16_t bg, uint8_t size) {
    if (c < 32 || c > 127) return;
    uint8_t idx = c - 32;
    int16_t w = 6 * size;
    int16_t h = 8 * size;

    if (w * h > 1024) return;

    for (int16_t i = 0; i < 8; i++) {
        for (int16_t j = 0; j < 5; j++) {
            uint8_t pixel_on = (font5x8[idx * 5 + j] & (1 << i));
            uint16_t pColor = pixel_on ? color : bg;
            for (int16_t dy = 0; dy < size; dy++) {
                for (int16_t dx = 0; dx < size; dx++) {
                    gfx_buffer[(i * size + dy) * w + (j * size + dx)] = pColor;
                }
            }
        }
        for (int16_t dy = 0; dy < size; dy++) {
            for (int16_t dx = 0; dx < size; dx++) {
                gfx_buffer[(i * size + dy) * w + (5 * size + dx)] = bg;
            }
        }
    }
    GC9A01A_draw_pixels(tft, x, y, gfx_buffer, w, h);
}

// Hàm in chuỗi văn bản
void TFT_DrawString(GC9A01A *tft, const char* str, int16_t x, int16_t y, uint16_t color, uint16_t bg) {
    int16_t len = strlen(str);
    int16_t width = len * 6 * current_text_size;
    int16_t height = 8 * current_text_size;
    int16_t cur_x = x;
    int16_t cur_y = y;

    if (current_text_datum == TC_DATUM || current_text_datum == CC_DATUM || current_text_datum == BC_DATUM) {
        cur_x = x - (width / 2);
    } else if (current_text_datum == TR_DATUM || current_text_datum == MR_DATUM || current_text_datum == BR_DATUM) {
        cur_x = x - width;
    }
    if (current_text_datum == CC_DATUM || current_text_datum == ML_DATUM || current_text_datum == MR_DATUM) {
        cur_y = y - (height / 2);
    } else if (current_text_datum == BC_DATUM || current_text_datum == BL_DATUM || current_text_datum == BR_DATUM) {
        cur_y = y - height;
    }

    for (int i = 0; i < len; i++) {
        TFT_DrawChar(tft, cur_x, cur_y, str[i], color, bg, current_text_size);
        cur_x += 6 * current_text_size;
    }
}

// Hàm vẽ đường tròn
void TFT_DrawCircle(GC9A01A *tft, int16_t x0, int16_t y0, int16_t r, uint16_t color) {
    int x = r, y = 0, dx = 1, dy = 1, err = dx - (r << 1);
    while (x >= y) {
        GC9A01A_draw_pixel(tft, x0 + x, y0 + y, color);
        GC9A01A_draw_pixel(tft, x0 + y, y0 + x, color);
        GC9A01A_draw_pixel(tft, x0 - y, y0 + x, color);
        GC9A01A_draw_pixel(tft, x0 - x, y0 + y, color);
        GC9A01A_draw_pixel(tft, x0 - x, y0 - y, color);
        GC9A01A_draw_pixel(tft, x0 - y, y0 - x, color);
        GC9A01A_draw_pixel(tft, x0 + y, y0 - x, color);
        GC9A01A_draw_pixel(tft, x0 + x, y0 - y, color);
        if (err <= 0) { y++; err += dy; dy += 2; }
        if (err > 0) { x--; dx += 2; err += dx - (r << 1); }
    }
}

void TFT_FillCircle(GC9A01A *tft, int16_t x0, int16_t y0, int16_t r, uint16_t color) {
    for (int y = -r; y <= r; y++) {
        for (int x = -r; x <= r; x++) {
            if (x * x + y * y <= r * r) {
                GC9A01A_draw_pixel(tft, x0 + x, y0 + y, color);
            }
        }
    }
}

void TFT_FillTriangle(GC9A01A *tft, int16_t x0, int16_t y0, int16_t x1, int16_t y1, int16_t x2, int16_t y2, uint16_t color) {
    int minX = fmin(x0, fmin(x1, x2)); int maxX = fmax(x0, fmax(x1, x2));
    int minY = fmin(y0, fmin(y1, y2)); int maxY = fmax(y0, fmax(y1, y2));
    for (int y = minY; y <= maxY; y++) {
        for (int x = minX; x <= maxX; x++) {
            int w0 = (x1 - x0) * (y - y0) - (y1 - y0) * (x - x0);
            int w1 = (x2 - x1) * (y - y1) - (y2 - y1) * (x - x1);
            int w2 = (x0 - x2) * (y - y2) - (y0 - y2) * (x - x2);
            if ((w0 >= 0 && w1 >= 0 && w2 >= 0) || (w0 <= 0 && w1 <= 0 && w2 <= 0)) {
                GC9A01A_draw_pixel(tft, x, y, color);
            }
        }
    }
}
